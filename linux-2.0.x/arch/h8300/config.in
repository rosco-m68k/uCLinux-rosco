## linux-2.0.x/arch/niosnommu/config.in
```kconfig
#
# For a description of the syntax of this configuration file,
# see the Configure script.
#
mainmenu_name 'uClinux/Nios (w/o MMU) Kernel Configuration'

define_bool CONFIG_UCLINUX y


mainmenu_option next_comment
comment 'Code maturity level options'
bool 'Prompt for development and/or incomplete code/drivers' CONFIG_EXPERIMENTAL
endmenu

mainmenu_option next_comment
comment 'Loadable module support'
bool 'Enable loadable module support' CONFIG_MODULES
# if [ "$CONFIG_MODULES" = "y" ]; then
#   bool 'Set version information on all symbols for modules' CONFIG_MODVERSIONS
#   bool 'Kernel daemon support (e.g. autoload of modules)' CONFIG_KERNELD
# fi
endmenu


mainmenu_option next_comment
comment 'Platform dependant setup'

choice 'CPU' \
	"NIOS	CONFIG_NIOS" NIOS

comment 'Platform'

choice 'Platform' \
	"EXCALIBUR	CONFIG_EXCALIBUR" EXCALIBUR

# choice 'Kernel executes from' \
#	"RAM	CONFIG_RAMKERNEL \
#	 ROM	CONFIG_ROMKERNEL" ROM

bool 'Flash CRC support' CONFIG_CRC_CHECK
if [ "$CONFIG_CRC_CHECK" = "y" ]; then
  bool '  Prompt for action on failure' CONFIG_PROMPT_ON_MISSING_CRC_TABLES
fi

endmenu

mainmenu_option next_comment
comment 'General setup'

# bool 'PCI bios support' CONFIG_PCI
# if [ "$CONFIG_PCI" = "y" ]; then
#	bool '    PCI device list support' CONFIG_PCIDEVLIST
# fi

bool 'Networking support' CONFIG_NET
bool 'System V IPC' CONFIG_SYSVIPC
bool 'Reduced memory footprint' CONFIG_REDUCED_MEMORY
tristate 'Kernel support for flat binaries' CONFIG_BINFMT_FLAT
# tristate 'Kernel support for a.out binaries' CONFIG_BINFMT_AOUT
# tristate 'Kernel support for ELF binaries' CONFIG_BINFMT_ELF
# bool 'Compile kernel as ELF - if your GCC is ELF-GCC' CONFIG_KERNEL_ELF
bool 'Frame buffer support' CONFIG_FRAMEBUFFER
if [ "$CONFIG_FRAMEBUFFER" = "y" ]; then
	bool ' epson S1D13505 frame buffer' CONFIG_E1355FB
	if [ "$CONFIG_E1355FB" = "y" ]; then	
		bool ' Virtual console support' CONFIG_CONSOLE
		if [ "$CONFIG_CONSOLE" = "y" ]; then
			define_bool CONFIG_FBCON_FONTS y
		#	comment ' Select compiled-in fonts(at least one)' 
			if [ "$CONFIG_FBCON_FONTS" = "y" ]; then
		 		bool '   VGA 8x8 font' CONFIG_FONT_8x8
		 		bool '   VGA 8x16 font' CONFIG_FONT_8x16
		 		bool '   Pearl 8x8 font' CONFIG_FONT_PEARL8x8
		 		if [ "$CONFIG_FONT_8x16" = "n" -a "$CONFIG_FONT_PEARL8x8" = "n" ]; then
	 				define_bool CONFIG_FONT_8x8 	y
		 		fi
		 	fi
		fi
		if [ "$CONFIG_CONSOLE" = "y" ]; then
			bool '   Booting from frame buffer based console' CONFIG_BOOT_FBCONSOLE
		fi
	fi	
fi
bool 'Kernel support for remote GDB client' CONFIG_KGDB
if [ "$CONFIG_KGDB" = "y" ]; then
  bool '  Include breakpoint trap on kernel startup' CONFIG_BREAK_ON_START
fi
endmenu

string 'Initial kernel command string' CONFIG_CMDLINE "CONSOLE=/dev/ttyS0 root=/dev/rom0 ro"

#
# Block device driver configuration
#
define_bool CONFIG_PCI n
source drivers/block/Config.in

tristate 'FLASH device support' CONFIG_DEV_FLASH
if [ "$CONFIG_DEV_FLASH" = "y" ]; then
  bool '   FLASH Block device' CONFIG_BLK_DEV_FLASH
  bool '   FLASH Character device' CONFIG_CHR_DEV_FLASH
fi

if [ "$CONFIG_NET" = "y" ]; then
  source net/Config.in
fi

if [ "$CONFIG_NET" = "y" ]; then

mainmenu_option next_comment
comment 'Network device support'

bool 'Network device support' CONFIG_NETDEVICES
if [ "$CONFIG_NETDEVICES" = "y" ]; then
#
# Network device configuration
#
tristate 'Dummy net driver support' CONFIG_DUMMY
tristate 'SLIP (serial line) support' CONFIG_SLIP
if [ "$CONFIG_SLIP" != "n" ]; then
  bool ' CSLIP compressed headers' CONFIG_SLIP_COMPRESSED
  bool ' Keepalive and linefill' CONFIG_SLIP_SMART
  bool ' Six bit SLIP encapsulation' CONFIG_SLIP_MODE_SLIP6
fi
tristate 'PPP (point-to-point) support' CONFIG_PPP
if [ ! "$CONFIG_PPP" = "n" ]; then
  comment 'CCP compressors for PPP are only built as modules.'
fi
tristate 'EQL (serial line load balancing) support' CONFIG_EQUALIZER
bool 'Cirrus Logic cs8900 ethernet' CONFIG_UCCS8900

fi
endmenu
fi

source fs/Config.in

mainmenu_option next_comment
comment 'Character devices'

# tristate 'Parallel printer support' CONFIG_PRINTER
# bool 'Support for user misc device modules' CONFIG_UMISC
if [ "$CONFIG_EXCALIBUR" = "y" ]; then
	bool 'NIOS serial support' CONFIG_NIOS_SERIAL
	bool 'SPI device support. (H/W MUST be built into core)' CONFIG_NIOS_SPI
fi

# bool 'Support for user serial device modules' CONFIG_USERIAL
# bool 'Watchdog Timer Support'	CONFIG_WATCHDOG
# if [ "$CONFIG_WATCHDOG" != "n" ]; then
#   bool '   Disable watchdog shutdown on close' CONFIG_WATCHDOG_NOWAYOUT
#   bool '   Software Watchdog' CONFIG_SOFT_WATCHDOG
# fi
endmenu



# mainmenu_option next_comment
# comment 'Sound support'
#
# tristate 'Sound support' CONFIG_SOUND
# endmenu

mainmenu_option next_comment
comment 'Kernel hacking'

# bool 'Debug kmalloc/kfree' CONFIG_DEBUG_MALLOC
bool 'Kernel profiling support' CONFIG_PROFILE
if [ "$CONFIG_PROFILE" = "y" ]; then
  int ' Profile shift count' CONFIG_PROFILE_SHIFT 2
fi
endmenu
```

## linux-2.0.x/arch/or32/config.in
```kconfig
#
# For a description of the syntax of this configuration file,
# see the Configure script.
#
mainmenu_name 'uClinux/OR1K (w/o MMU) Kernel Configuration'

define_bool CONFIG_UCLINUX y

mainmenu_option next_comment
comment 'Code maturity level options'
bool 'Prompt for development and/or incomplete code/drivers' CONFIG_EXPERIMENTAL
endmenu

# mainmenu_option next_comment
# comment 'Loadable module support'
# bool 'Enable loadable module support' CONFIG_MODULES
# if [ "$CONFIG_MODULES" = "y" ]; then
#   bool 'Set version information on all symbols for modules' CONFIG_MODVERSIONS
#   bool 'Kernel daemon support (e.g. autoload of modules)' CONFIG_KERNELD
# fi
# endmenu


mainmenu_option next_comment
comment 'Platform dependant setup'

choice 'CPU' \
	"OR32		CONFIG_OR32" OR32

comment 'Platform'

if [ "$CONFIG_OR32" = "y" ]; then
	bool 'General OR32 board support' CONFIG_GEN
fi

choice 'Kernel executes from' \
	"RAM	CONFIG_RAMKERNEL \
	 ROM	CONFIG_ROMKERNEL" RAM

endmenu

mainmenu_option next_comment
comment 'General setup'

bool 'PCI bios support' CONFIG_PCI
if [ "$CONFIG_PCI" = "y" ]; then
	bool '    PCI device list support' CONFIG_PCIDEVLIST
fi

bool 'Networking support' CONFIG_NET
bool 'System V IPC' CONFIG_SYSVIPC
bool 'Reduced memory footprint' CONFIG_REDUCED_MEMORY
tristate 'Kernel support for flat binaries' CONFIG_BINFMT_FLAT
# tristate 'Kernel support for a.out binaries' CONFIG_BINFMT_AOUT
tristate 'Kernel support for ELF binaries' CONFIG_BINFMT_ELF
bool 'Compile kernel as ELF - if your GCC is ELF-GCC' CONFIG_KERNEL_ELF
bool 'Console support' CONFIG_CONSOLE
if [ "$CONFIG_CONSOLE" = "y" ]; then
	bool 'Enable serial echo' CONFIG_SERIAL_ECHO
	bool 'Frame buffer' CONFIG_FRAMEBUFFER
fi

endmenu

#
# Block device driver configuration
#
mainmenu_option next_comment
comment 'Floppy, IDE, and other block devices'

tristate 'ROM disk memory block device' CONFIG_BLK_DEV_BLKMEM
# tristate 'Normal floppy disk support' CONFIG_BLK_DEV_FD
bool 'IDE harddisk support' CONFIG_BLK_DEV_IDE
if [ "$CONFIG_BLK_DEV_IDE" = "y" ]; then
  bool '   Include IDE/ATAPI CDROM support' CONFIG_BLK_DEV_IDECD
  bool '   Include IDE/ATAPI TAPE support' CONFIG_BLK_DEV_IDETAPE
  bool '   Include IDE/ATAPI FLOPPY support (new)' CONFIG_BLK_DEV_IDEFLOPPY
fi

comment 'Additional Block/FLASH Devices'

tristate 'Loopback device support' CONFIG_BLK_DEV_LOOP
bool 'Multiple devices driver support' CONFIG_BLK_DEV_MD
if [ "$CONFIG_BLK_DEV_MD" = "y" ]; then
  tristate '   Linear (append) mode' CONFIG_MD_LINEAR
  tristate '   RAID-0 (striping) mode' CONFIG_MD_STRIPED
fi
tristate 'RAM disk support' CONFIG_BLK_DEV_RAM
if [ "$CONFIG_BLK_DEV_RAM" = "y" ]; then
  bool '   Release empty RAM disk blocks' CONFIG_RD_RELEASE_BLOCKS
  bool '   Initial RAM disk (initrd) support' CONFIG_BLK_DEV_INITRD
fi
tristate 'FLASH device support' CONFIG_DEV_FLASH
if [ "$CONFIG_DEV_FLASH" = "y" ]; then
  bool '   FLASH Block device' CONFIG_BLK_DEV_FLASH
  bool '   FLASH Character device' CONFIG_CHR_DEV_FLASH
fi
endmenu

if [ "$CONFIG_NET" = "y" ]; then
  source net/Config.in
fi

if [ "$CONFIG_NET" = "y" ]; then

mainmenu_option next_comment
comment 'Network device support'

bool 'Network device support' CONFIG_NETDEVICES
if [ "$CONFIG_NETDEVICES" = "y" ]; then
#
# Network device configuration
#
tristate 'Dummy net driver support' CONFIG_DUMMY
tristate 'SLIP (serial line) support' CONFIG_SLIP
if [ "$CONFIG_SLIP" != "n" ]; then
  bool ' CSLIP compressed headers' CONFIG_SLIP_COMPRESSED
  bool ' Keepalive and linefill' CONFIG_SLIP_SMART
  bool ' Six bit SLIP encapsulation' CONFIG_SLIP_MODE_SLIP6
fi
tristate 'PPP (point-to-point) support' CONFIG_PPP
if [ ! "$CONFIG_PPP" = "n" ]; then
  comment 'CCP compressors for PPP are only built as modules.'
fi
tristate 'EQL (serial line load balancing) support' CONFIG_EQUALIZER
bool 'Open ethernet core' CONFIG_OETH

fi
endmenu
fi

source fs/Config.in

mainmenu_option next_comment
comment 'Character devices'

bool 'Serial support' CONFIG_SERIAL
# bool 'Support for user serial device modules' CONFIG_USERIAL
bool 'Watchdog Timer Support'	CONFIG_WATCHDOG
# if [ "$CONFIG_WATCHDOG" != "n" ]; then
#   bool '   Disable watchdog shutdown on close' CONFIG_WATCHDOG_NOWAYOUT
#   bool '   Software Watchdog' CONFIG_SOFT_WATCHDOG
# fi
bool 'PS/2 Keyboard' CONFIG_KEYBOARD
endmenu

# mainmenu_option next_comment
# comment 'Sound support'
#
# tristate 'Sound support' CONFIG_SOUND
# endmenu

mainmenu_option next_comment
comment 'Kernel hacking'

# bool 'Debug kmalloc/kfree' CONFIG_DEBUG_MALLOC
bool 'Kernel profiling support' CONFIG_PROFILE
if [ "$CONFIG_PROFILE" = "y" ]; then
  int ' Profile shift count' CONFIG_PROFILE_SHIFT 2
fi
endmenu
```

## linux-2.0.x/arch/shnommu/config.in
```kconfig
#
# For a description of the syntax of this configuration file,
# see the Configure script.
#
mainmenu_name 'uClinux/sh (w/o MMU) Kernel Configuration'

define_bool CONFIG_UCLINUX y
define_bool CONFIG_SHNOMMU y

mainmenu_option next_comment
comment 'Code maturity level options'
bool 'Prompt for development and/or incomplete code/drivers' CONFIG_EXPERIMENTAL
endmenu

# mainmenu_option next_comment
# comment 'Loadable module support'
# bool 'Enable loadable module support' CONFIG_MODULES
# if [ "$CONFIG_MODULES" = "y" ]; then
#   bool 'Set version information on all symbols for modules' CONFIG_MODVERSIONS
#   bool 'Kernel daemon support (e.g. autoload of modules)' CONFIG_KERNELD
# fi
# endmenu


mainmenu_option next_comment
comment 'Platform dependant setup'

choice 'CPU' \
	"SH7615		CONFIG_SH7615" SH7615

comment 'Platform'

if [ "$CONFIG_SH7615" = "y" ]; then
	bool 'Hewtech SH7615 Board support' CONFIG_HEWTECH
fi

choice 'Kernel executes from' \
	"RAM	CONFIG_RAMKERNEL \
	 ROM	CONFIG_ROMKERNEL" ROM

endmenu

mainmenu_option next_comment
comment 'General setup'

bool 'PCI bios support' CONFIG_PCI
if [ "$CONFIG_PCI" = "y" ]; then
	bool '    PCI device list support' CONFIG_PCIDEVLIST
fi

bool 'Networking support' CONFIG_NET
bool 'System V IPC' CONFIG_SYSVIPC
bool 'Reduced memory footprint' CONFIG_REDUCED_MEMORY
tristate 'Kernel support for flat binaries' CONFIG_BINFMT_FLAT
# tristate 'Kernel support for a.out binaries' CONFIG_BINFMT_AOUT
# tristate 'Kernel support for ELF binaries' CONFIG_BINFMT_ELF
bool 'Compile kernel as ELF - if your GCC is ELF-GCC' CONFIG_KERNEL_ELF
bool 'Console support' CONFIG_CONSOLE
if [ "$CONFIG_CONSOLE" = "y" ]; then
	bool 'Frame buffer' CONFIG_FRAMEBUFFER
fi

endmenu

#
# Block device driver configuration
#
mainmenu_option next_comment
comment 'Floppy, IDE, and other block devices'

tristate 'ROM disk memory block device' CONFIG_BLK_DEV_BLKMEM
# tristate 'Normal floppy disk support' CONFIG_BLK_DEV_FD
bool 'IDE harddisk support' CONFIG_BLK_DEV_IDE
if [ "$CONFIG_BLK_DEV_IDE" = "y" ]; then
  bool '   Include IDE/ATAPI CDROM support' CONFIG_BLK_DEV_IDECD
  bool '   Include IDE/ATAPI TAPE support' CONFIG_BLK_DEV_IDETAPE
  bool '   Include IDE/ATAPI FLOPPY support (new)' CONFIG_BLK_DEV_IDEFLOPPY
fi

comment 'Additional Block/FLASH Devices'

tristate 'Loopback device support' CONFIG_BLK_DEV_LOOP
bool 'Multiple devices driver support' CONFIG_BLK_DEV_MD
if [ "$CONFIG_BLK_DEV_MD" = "y" ]; then
  tristate '   Linear (append) mode' CONFIG_MD_LINEAR
  tristate '   RAID-0 (striping) mode' CONFIG_MD_STRIPED
fi
tristate 'RAM disk support' CONFIG_BLK_DEV_RAM
if [ "$CONFIG_BLK_DEV_RAM" = "y" ]; then
  bool '   Release empty RAM disk blocks' CONFIG_RD_RELEASE_BLOCKS
#  bool '   Initial RAM disk (initrd) support' CONFIG_BLK_DEV_INITRD
fi
tristate 'FLASH device support' CONFIG_DEV_FLASH
if [ "$CONFIG_DEV_FLASH" = "y" ]; then
  bool '   FLASH Block device' CONFIG_BLK_DEV_FLASH
  bool '   FLASH Character device' CONFIG_CHR_DEV_FLASH
fi
endmenu

if [ "$CONFIG_NET" = "y" ]; then
  source net/Config.in
fi

if [ "$CONFIG_NET" = "y" ]; then

mainmenu_option next_comment
comment 'Network device support'

bool 'Network device support' CONFIG_NETDEVICES
if [ "$CONFIG_NETDEVICES" = "y" ]; then
#
# Network device configuration
#
tristate 'Dummy net driver support' CONFIG_DUMMY
tristate 'SLIP (serial line) support' CONFIG_SLIP
if [ "$CONFIG_SLIP" != "n" ]; then
  bool ' CSLIP compressed headers' CONFIG_SLIP_COMPRESSED
  bool ' Keepalive and linefill' CONFIG_SLIP_SMART
  bool ' Six bit SLIP encapsulation' CONFIG_SLIP_MODE_SLIP6
fi
tristate 'PPP (point-to-point) support' CONFIG_PPP
if [ ! "$CONFIG_PPP" = "n" ]; then
  comment 'CCP compressors for PPP are only built as modules.'
fi
tristate 'EQL (serial line load balancing) support' CONFIG_EQUALIZER
bool 'Cirrus Logic cs8900 ethernet' CONFIG_UCCS8900
if [ "$CONFIG_UCCS8900" != "n" ]; then
	bool 'Hardware byte-swapping support for cs8900 ethernet' CONFIG_UCCS8900_HW_SWAP
fi

tristate 'SH2 EtherC support' CONFIG_ETHERC_SH2

bool 'SMC 9194 ethernet' CONFIG_SMC9194
bool 'NE2000/NE1000 ISA ethernet' CONFIG_NE2000

fi
endmenu
fi

source fs/Config.in

mainmenu_option next_comment
comment 'Character devices'
tristate 'SH7615 Serial support' CONFIG_SH7615_SERIAL

# tristate 'Parallel printer support' CONFIG_PRINTER
# bool 'Support for user misc device modules' CONFIG_UMISC

# bool 'Support for user serial device modules' CONFIG_USERIAL
bool 'Watchdog Timer Support'	CONFIG_WATCHDOG
# if [ "$CONFIG_WATCHDOG" != "n" ]; then
#   bool '   Disable watchdog shutdown on close' CONFIG_WATCHDOG_NOWAYOUT
#   bool '   Software Watchdog' CONFIG_SOFT_WATCHDOG
# fi
endmenu

# mainmenu_option next_comment
# comment 'Sound support'
#
# tristate 'Sound support' CONFIG_SOUND
# endmenu

mainmenu_option next_comment
comment 'Kernel hacking'

# bool 'Debug kmalloc/kfree' CONFIG_DEBUG_MALLOC
bool 'Kernel profiling support' CONFIG_PROFILE
if [ "$CONFIG_PROFILE" = "y" ]; then
  int ' Profile shift count' CONFIG_PROFILE_SHIFT 2
fi
endmenu
```
