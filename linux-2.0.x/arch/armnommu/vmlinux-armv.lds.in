/* ld script to make ARM Linux kernel
 * taken from the i386 version by Russell King
 * Written by Martin Mares <mj@atrey.karlin.mff.cuni.cz>
 */
OUTPUT_ARCH(arm)
ENTRY(stext)
SECTIONS
{
	.text : {			/* Real text segment		*/
		_stext = .;		/* Text and read-only data	*/
		stext = .;
			*(.text)
			*(.fixup)
			*(.gnu.warning)
			*(.text.lock)	/* out-of-line lock text */
			*(.rodata)
			*(.glue_7)
			*(.glue_7t)
			*(.kstrtab)
		. = ALIGN(16);
		etext = .;
		_etext = .;		/* End of text section		*/
	}

	. = ALIGN(16);

	.data : {
		_sdata = .;
		*(.data)
		CONSTRUCTORS
		_edata = .;
	}

	. = ALIGN(16);

	.bss : {
		_sbss = .;		/* BSS				*/
		*(.bss)
		*(COMMON)
		_ebss = .;
		_end = . ;
	}

					/* Stabs debugging sections.	*/
	.stab 0 : { *(.stab) }
	.stabstr 0 : { *(.stabstr) }
	.stab.excl 0 : { *(.stab.excl) }
	.stab.exclstr 0 : { *(.stab.exclstr) }
	.stab.index 0 : { *(.stab.index) }
	.stab.indexstr 0 : { *(.stab.indexstr) }
	.comment 0 : { *(.comment) }
}
